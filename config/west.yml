## config/west.yml
```yaml
manifest:
  remotes:
    - name: zmkfirmware
      url-base: https://github.com/zmkfirmware
    - name: iwk7273
      url-base: https://github.com/iwk7273
    - name: prospector
      url-base: https://github.com/t-ogura
  projects:
    # 上流の新トラックボール方式（ball-profile / scroll_transform）に一致する
    # 2026-08-25 の commit にピン留めしてドリフトを防止（zmk フォークと
    # meteorite-config は密結合のため必ず同世代で揃える）。
    - name: zmk
      remote: iwk7273
      revision: 3dfcd49add849e466f87b482464e9f28403b2c82  # feat/meteorite-custom-config-rpc @ 2026-08-25
      import: app/west.yml
    - name: zmk-pmw3610-driver
      remote: iwk7273
      revision: 8af03264f272dd709f50cca8b80c835294e1f320  # main @ 2026-02-21
    - name: zmk-feature-meteorite-config
      remote: iwk7273
      revision: 4d2728b77c1fe8374ef94cc3dc6bd88d0c9d1176  # main @ 2026-08-25
    - name: prospector-zmk-module
      remote: prospector
      revision: v2.2.3  # Scanner Touch 対応の現行版（README 推奨）
      path: modules/prospector-zmk-module
  self:
    path: config
```
