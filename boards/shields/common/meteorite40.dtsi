#include <zephyr/dt-bindings/input/input-event-codes.h>
#include <dt-bindings/zmk/matrix_transform.h>
#include <dt-bindings/zmk/input_transform.h>
#include <input/processors.dtsi>
/*
 * NOTE: keys.h はここでは include しない。keys.h(modifiers.h) が定義する
 * RC(keycode)（右Ctrl修飾, 1引数）が matrix_transform.h の RC(row,col)（2引数）
 * を潰し、同一プリプロセスで後続する keymap の RC() 修飾（layer_4 の RC(T) 等）と
 * 衝突するため。ball_profile_router のジェスチャ binding は keys.h を使わず
 * &none（未使用: OFF/SCROLL プロファイルのみ運用）にしてある。

#define DEFAULT_CPI 600         // トラックボールの感度
#define ROTATION_ANGLE 20       // トラックボールのY軸を回転
#define SCROLL_THRESHOLD 20     // スクロール1ステップのraw count閾値

// Ball Profile 値（enum zmk_ball_profile / zmk.meteorite.BallProfile と一致させること）
#define BALL_OFF 0
#define BALL_SCROLL 1
#define BALL_SENS_NORMAL 2

#define INVERT_X 0              // X軸のスクロールの反転
#define INVERT_Y 1              // Y軸のスクロールの反転（現状の逆＝反転を維持）

#define SCALING_MODE 0          // 0: 無効, 1: 有効（カーソル加速。0=等倍で素通し）
#define POINTER_PROFILE 0       // 0: 標準, 1: 安定, 2: 軽快, 3: ワイド
#define SCROLL_SCALING_MODE 0   // 0: Linear, 1: Adaptive
#define OS_MODE_DEFAULT 0       // 0: Win, 1: Mac

#define POINTER_DEFAULT_DT_MS 12 // reset直後の物理速度計算に使う既定report間隔
#define SCROLL_DEFAULT_DT_MS 12  // reset直後の物理速度計算に使う既定report間隔

#define POLL_PERIOD_MS 15       // キースキャンのポーリング周期（ms）
#define DEBOUNCE_MS 10           // デバウンス時間 (ms)

&spi0 {
    status = "okay";
    compatible = "nordic,nrf-spim";
    cs-gpios = <&gpio1 15 GPIO_ACTIVE_LOW>; // CS: P1.15

    pinctrl-0 = <&spi0_default>;
    pinctrl-1 = <&spi0_sleep>;
    pinctrl-names = "default", "sleep";

    trackball: pmw3610@0 {
        compatible = "pixart,pmw3610-custom";
        reg = <0>;
        spi-max-frequency = <2000000>;
        irq-gpios = <&gpio1 12 (GPIO_ACTIVE_LOW | GPIO_PULL_UP)>; // MOTION: P1.12
        cpi = <DEFAULT_CPI>;
        evt-type = <INPUT_EV_REL>;
        x-input-code = <INPUT_REL_X>;
        y-input-code = <INPUT_REL_Y>;
        force-awake;
        //force-awake-4ms-mode;
        status = "okay";
    };
};

&pinctrl {
    spi0_default: spi0_default {
        group1 {
            psels = <NRF_PSEL(SPIM_SCK, 1, 13)>,   // SCLK:  P1.13
                    <NRF_PSEL(SPIM_MOSI, 1, 14)>,  // SDIO:  P1.14
                    <NRF_PSEL(SPIM_MISO, 1, 14)>;  // MISOは同じSDIO兼用
        };
    };

    spi0_sleep: spi0_sleep {
        group1 {
            psels = <NRF_PSEL(SPIM_SCK, 1, 13)>,
                    <NRF_PSEL(SPIM_MOSI, 1, 14)>,
                    <NRF_PSEL(SPIM_MISO, 1, 14)>;
            low-power-enable;
        };
    };
};

/ {
    meteorite40_scan: kscan0 {
        compatible = "zmk,kscan-gpio-charlieplex";
        gpios = <&gpio0 2 GPIO_ACTIVE_HIGH>,  // ID0: P0.02
                <&gpio0 3 GPIO_ACTIVE_HIGH>,  // ID1: P0.03
                <&gpio0 28 GPIO_ACTIVE_HIGH>, // ID2: P0.28
                <&gpio0 29 GPIO_ACTIVE_HIGH>, // ID3: P0.29
                <&gpio0 4 GPIO_ACTIVE_HIGH>,  // ID4: P0.04
                <&gpio0 5 GPIO_ACTIVE_HIGH>,  // ID5: P0.05
                <&gpio1 11 GPIO_ACTIVE_HIGH>; // ID6: P1.11

        interrupt-gpios = <&gpio0 9 (GPIO_ACTIVE_HIGH | GPIO_PULL_DOWN)>; // Changed to P0.09 (NFC1)
        debounce-press-ms = <DEBOUNCE_MS>;
        debounce-release-ms = <DEBOUNCE_MS>;
        poll-period-ms = <POLL_PERIOD_MS>;
        wakeup-source;
    };

    motion_scaler: motion_scaler {
        compatible = "zmk,input-processor-meteorite-motion-scaler";
        #input-processor-cells = <0>;
        scaling-mode = <SCALING_MODE>;
        pointer-profile = <POINTER_PROFILE>;
        cpi = <DEFAULT_CPI>;
        default-dt-ms = <POINTER_DEFAULT_DT_MS>;
    };

    scroll_transform: scroll_transform {
        compatible = "zmk,input-processor-meteorite-scroll-transform";
        #input-processor-cells = <0>;
        threshold = <SCROLL_THRESHOLD>;
        invert-x = <INVERT_X>;
        invert-y = <INVERT_Y>;
        scaling-mode = <SCROLL_SCALING_MODE>;
        cpi = <DEFAULT_CPI>;
        default-dt-ms = <SCROLL_DEFAULT_DT_MS>;
    };

    sensor_rotation: sensor_rotation {
        compatible = "zmk,input-meteorite-sensor-rotation";
        device = <&trackball>;
        rotation-angle = <ROTATION_ANGLE>;
    };

    /*
     * NOTE: これらのノードを #if CONFIG_ZMK_CUSTOM_CONFIG で囲ってはいけない。
     * Zephyr は devicetree のプリプロセスを Kconfig より先に実行するため、DTS
     * 内では CONFIG_* マクロが未定義（=偽）になり、ノードごと DT から除外され、
     * default 値が一切読めなくなる。
     */
    ball_profile_defaults: ball_profile_defaults {
        compatible = "zmk,ball-profile-defaults";
        /* レイヤ index 順: 0=BASE 1=SYMBOLS 2=NUM/ARROW 3=FUNCTION 4=SETTING
         * 5=SCROLL 6=RESERVE 7=RESERVE。
         * レイヤー5のみ SCROLL、他は OFF（通常カーソル）。 */
        layer-profiles = <BALL_OFF BALL_OFF BALL_OFF BALL_OFF BALL_OFF
                          BALL_SCROLL BALL_OFF BALL_OFF>;
        sensitivity = <BALL_SENS_NORMAL>;
    };

    custom_config_defaults: custom_config_defaults {
        compatible = "zmk,custom-config-defaults";
        os-mode = <OS_MODE_DEFAULT>;
        idle-timeout-s = <120>;
        idle-sleep-timeout-s = <900>;
    };

    ball_profile_router: ball_profile_router {
        compatible = "zmk,input-processor-meteorite-ball-profile";
        #input-processor-cells = <0>;
        /* SCROLL プロファイル時に適用するサブチェーン（scroll transform）。 */
        input-processors = <&scroll_transform>;
        /* 固定 Profile の 12 binding（profile-major / 方向 LEFT,RIGHT,UP,DOWN）。
         * BROWSER/DESKTOP/WINDOW ジェスチャは未使用（layer-profiles は OFF/SCROLL のみ）
         * のため &none。使いたくなったら keys.h 衝突を避けた形で差し替える。 */
        bindings =
            <&none>, <&none>, <&none>, <&none>,
            <&none>, <&none>, <&none>, <&none>,
            <&none>, <&none>, <&none>, <&none>;
    };

    trackball_listener {
        compatible = "zmk,input-listener";
        device = <&sensor_rotation>;

        input-processors = <&ball_profile_router>,
                           <&motion_scaler>;
    };
};
